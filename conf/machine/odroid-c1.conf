## conf/machine/odroid-c1.conf
```bitbake
#
# This file is part of Liri.
#
# Copyright (C) 2017 Pier Luigi Fiorini <pierluigi.fiorini@gmail.com>
#
# $BEGIN_LICENSE:GPL3+$
#
# This program is free software: you can redistribute it and/or modify
# it under the terms of the GNU General Public License as published by
# the Free Software Foundation, either version 3 of the License, or
# (at your option) any later version.
#
# This program is distributed in the hope that it will be useful,
# but WITHOUT ANY WARRANTY; without even the implied warranty of
# MERCHANTABILITY or FITNESS FOR A PARTICULAR PURPOSE.  See the
# GNU General Public License for more details.
#
# You should have received a copy of the GNU General Public License
# along with this program.  If not, see <http://www.gnu.org/licenses/>.
#
# $END_LICENSE$
#

#@TYPE: Machine
#@NAME: ODROID C1 Development Board
#@DESCRIPTION: Machine configuration for the ODROID C1 board by Hardkernel

DEFAULTTUNE ?= "cortexa5hf-neon"

require conf/machine/include/tune-cortexa5.inc

TARGET_ARCH = "arm"

MACHINE_ESSENTIAL_EXTRA_RRECOMMENDS += " \
    u-boot-ini \
    kernel-image \
    kernel-devicetree \
"

MACHINE_EXTRA_RRECOMMENDS += " \
    kernel-modules \
"

PREFERRED_PROVIDER_virtual/kernel = "linux-hardkernel"

PREFERRED_PROVIDER_virtual/bootloader = "u-boot-hardkernel"
PREFERRED_PROVIDER_u-boot = "u-boot-hardkernel"
PREFERRED_VERSION_u-boot-hardkernel = "v2011.03%"

UBOOT_MACHINE = "odroidc_config"

KERNEL_DEVICETREE = "meson8b_odroidc.dtb"

KERNEL_IMAGETYPE ?= "uImage"
IMAGE_CLASSES += "odroidc-sdimg"
IMAGE_FSTYPES ?= "tar.gz ext4 odroidc-sdimg"

SERIAL_CONSOLE = "115200 ttyS0"
```
